#include "helper_keypos_34keys.h"
#define THUMBS LH1 LH0 RH0 RH1
#define EXTRA_LEFT
#define EXTRA_RIGHT
#define BASE_THUMBS &hml LALT TAB &lt SYM SPACE &lt NAV RET &sk_shft
#define NUE_THUMBS &hml LALT TAB &lt SYM SPACE &lt NAV RET &kp BSPC
#define SYM_THUMBS &trans &kp LGUI &trans &trans
#define NAV_THUMBS &kp N0 &lt SYM SPACE &trans &trans
#define TRI_THUMBS &trans &trans &trans &trans
#include "shared.keymap"
