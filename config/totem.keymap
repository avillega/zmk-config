#include "helper_keypos_38keys.h"
#define THUMBS LH2 LH1 LH0 RH0 RH1 RH2
#define EXTRA_LEFT &trans
#define EXTRA_RIGHT &trans
#define BASE_THUMBS &hml LALT TAB &lt SYM SPACE &none &none &lt NAV RET &sk_shft
#define NUE_THUMBS &hml LALT TAB &lt SYM SPACE &none &none &lt NAV RET &kp BSPC
#define SYM_THUMBS &trans &kp LGUI &trans &trans &trans &trans
#define NAV_THUMBS &kp N0 &lt SYM SPACE &none &none &trans &trans
#define TRI_THUMBS &trans &trans &trans &trans &trans &trans
#include "shared.keymap"
